## CMakeLists.txt
```
# Copyright (c) 2026 HardenedLinux Animula
# Author: Nala Ginrut <roy@hardenedlinux.org>
#
# SPDX-License-Identifier: LGPL-3.0-or-later

cmake_minimum_required(VERSION 3.20.0)

find_package(Zephyr REQUIRED HINTS $ENV{ZEPHYR_BASE})
project(alonzo_bootloader)

target_include_directories(app PRIVATE include src/fr8016)

# The FR8016HA flash algorithm (vendor .FLM) is NOT built into the bootloader:
# it is read from the TF card at runtime and parsed by src/fr8016/flm_elf.c.
# The file under vendor/flash_algorithms/ is only a deployable reference to copy
# onto the card.

target_sources(app PRIVATE
  src/main.c
  src/update.c
  src/firmware_update.c
  src/ble_update.c
  src/app_jump.c
  src/led.c
  src/tf.c
  src/fr8016/swd.c
  src/fr8016/dap.c
  src/fr8016/cortexm.c
  src/fr8016/flm.c
  src/fr8016/flm_elf.c
  src/fr8016/fr8016.c
)
```

## Kconfig
```
config ALONZO_FR8016_SWD_SELFTEST
	bool "FR8016HA SWD self-test (Phase 1-4 bring-up)"
	default n
	help
	  Replace the ble.bin update path with an SWD bring-up self-test: reset
	  the FR8016HA SWD line, read its DPIDR, power up the debug domain, read
	  the MEM-AP IDR, halt the Cortex-M3 core, read PC/SP/xPSR and run it
	  again, then parse and validate the external FR8010H.FLM from the TF card.
          Intended only for hardware bring-up of the SWD master; 
          Keep disabled in production!!!

config ALONZO_FR8016_RAM_BASE
	hex "FR8016HA SRAM base for the FLM work area"
	default 0x20000000
	help
	  Base of the FR8016HA SRAM window used to run the vendor .FLM flash
	  algorithm (code + data + BKPT stub + one 256-byte page buffer + stack).
	  The FLM is ROPI/RWPI so it runs at any RAM address; this just has to be
	  real, writable FR8016HA SRAM.

	  Per the FR801xH SDK User Guide: FR8016HA SRAM base = 0x20000000.

config ALONZO_FR8016_RAM_SIZE
	hex "FR8016HA SRAM size available for the FLM work area (bytes)"
	default 0xC000
	help
	  Size of the FR8016HA SRAM window reserved for the FLM work area. Must be
	  at least ~4 KB (the current FR8010H.FLM needs ~2.7 KB of code/data/BKPT
	  plus a 512-byte stack and a 256-byte page buffer).

	  Per the FR801xH SDK User Guide: FR8016HA SRAM size = 48 KB = 0xC000,
	  range 0x20000000 .. 0x2000BFFF (0x2000C000 is the exclusive end).

source "Kconfig.zephyr"
```

## prj.conf
```kconfig
# Copyright (c) 2026 HardenedLinux Animula
# Author: Nala Ginrut <roy@hardenedlinux.org>
#
# SPDX-License-Identifier: LGPL-3.0-or-later

# --- Image placement ------------------------------------------------------
# The bootloader lives at the start of flash and must fit inside the region
# reserved for it. Keep CONFIG_FLASH_LOAD_SIZE in sync with
# ALONZO_BOOTLOADER_SIZE (enforced by a BUILD_ASSERT in memory_layout.h).
CONFIG_FLASH_LOAD_OFFSET=0
CONFIG_FLASH_LOAD_SIZE=0x20000

# --- Console --------------------------------------------------------------
CONFIG_PRINTK=y
CONFIG_CONSOLE=y
CONFIG_UART_CONSOLE=y
CONFIG_SERIAL=y

# --- Flash driver (self-programming of the application region) ------------
CONFIG_FLASH=y
CONFIG_FLASH_PAGE_LAYOUT=y

# --- Micro-SD (TF) over SPI + FAT filesystem ------------------------------
CONFIG_GPIO=y
CONFIG_SPI=y
CONFIG_FILE_SYSTEM=y
CONFIG_FAT_FILESYSTEM_ELM=y
CONFIG_DISK_ACCESS=y
CONFIG_DISK_DRIVERS=y

# --- Minimal bootloader: no MPU / HW stack guard --------------------------
# The application re-enables these. Bootloader MPU regions would otherwise
# block the raw handoff to the application image.
CONFIG_ARM_MPU=n
CONFIG_HW_STACK_PROTECTION=n

# --- Sizing for FAT FS + SD + flash buffers -------------------------------
CONFIG_MAIN_STACK_SIZE=8192
CONFIG_HEAP_MEM_POOL_SIZE=8192
```

## src/main.c
```c
/*
 * Copyright (c) 2026 HardenedLinux Animula
 * Author: Nala Ginrut <roy@hardenedlinux.org>
 *
 * SPDX-License-Identifier: LGPL-3.0-or-later
 */

#include "app_jump.h"
#include "led.h"
#include "memory_layout.h"
#include "tf.h"
#include "update.h"

#include <zephyr/kernel.h>
#include <zephyr/sys/printk.h>

static void error_loop(const char *reason)
{
	led_all_off();
	led_set(ALONZO_LED_RED, true);
	printk("bootloader: %s\n", reason);
	for (;;) {
		k_sleep(K_SECONDS(1));
	}
}

int main(void)
{
	int rc;

	printk("Alonzo Maker Bootloader\n");

	led_init();
	led_all_off();

	/*
	 * Mount the TF card. If it is absent/unreadable we still boot the
	 * existing application: a missing SD card must not brick the device.
	 */
	rc = tf_mount();
	if (rc == 0) {
		rc = update_apply();
	} else {
		printk("bootloader: TF mount failed (%d), skipping update\n", rc);
		rc = 0;
	}

	/*
	 * Final LED state is resolved here, exactly once, from the update result:
	 *   failure -> red on, green off   (error_loop)
	 *   success -> green on, red off   (below)
	 * The burn helpers only blink red while flashing; they never decide the
	 * final state.
	 */
	if (rc < 0) {
		error_loop("update failed");
	}

	led_all_off();
	led_set(ALONZO_LED_GREEN, true);

	if (!app_image_valid(ALONZO_APP_START)) {
		error_loop("no valid application");
	}

	printk("bootloader: jumping to application at 0x%x\n",
	       (unsigned int)ALONZO_APP_START);
	app_jump(ALONZO_APP_START);

	/* app_jump() does not return. */
	error_loop("jump failed");
	return 0;
}
```

## include/app_jump.h
```c
/*
 * Copyright (c) 2026 HardenedLinux Animula
 * Author: Nala Ginrut <roy@hardenedlinux.org>
 *
 * SPDX-License-Identifier: LGPL-3.0-or-later
 */

#ifndef ALONZO_APP_JUMP_H
#define ALONZO_APP_JUMP_H

#include <stdbool.h>
#include <stdint.h>

/*
 * Validate a Cortex-M application image at @p app_start:
 *   - initial stack pointer (MSP) is inside SRAM
 *   - reset handler is inside the application flash region and thumb-aligned
 */
bool app_image_valid(uint32_t app_start);

/*
 * Perform a clean Cortex-M handoff to the application at @p app_start.
 * Does not return on success; returns (doing nothing) if the image is invalid.
 */
void app_jump(uint32_t app_start);

#endif /* ALONZO_APP_JUMP_H */
```

## include/ble_update.h
```c
/*
 * Copyright (c) 2026 HardenedLinux Animula
 * Author: Nala Ginrut <roy@hardenedlinux.org>
 *
 * SPDX-License-Identifier: LGPL-3.0-or-later
 */

#ifndef ALONZO_BLE_UPDATE_H
#define ALONZO_BLE_UPDATE_H

/*
 * FR8016HA (BLE) firmware update.
 *
 * The FR8016HA is a separate BLE co-processor. The update is performed over SWD
 * (PA2/PA3, USART2 in normal operation) using the vendor .FLM flash algorithm
 * running on the FR8016HA itself -- see src/fr8016/fr8016.c. The STM32 does not
 * implement a BLE stack and does not use the private FREQCHIP UART protocol.
 */

/* Update the FR8016HA firmware from /SD:ble.bin. Returns 0 / -errno. */
int ble_update(void);

#endif /* ALONZO_BLE_UPDATE_H */
```

## include/firmware_update.h
```c
/*
 * Copyright (c) 2026 HardenedLinux Animula
 * Author: Nala Ginrut <roy@hardenedlinux.org>
 *
 * SPDX-License-Identifier: LGPL-3.0-or-later
 */

#ifndef ALONZO_FIRMWARE_UPDATE_H
#define ALONZO_FIRMWARE_UPDATE_H

/*
 * Update the STM32 application firmware from /SD:firmware.bin.
 *
 * On success the update file is deleted. On failure the file is kept so the
 * next boot retries, and the red LED is left on.
 *
 * Returns 0 on success, a negative errno otherwise.
 */
int firmware_update(void);

#endif /* ALONZO_FIRMWARE_UPDATE_H */
```

## include/led.h
```c
/*
 * Copyright (c) 2026 HardenedLinux Animula
 * Author: Nala Ginrut <roy@hardenedlinux.org>
 *
 * SPDX-License-Identifier: LGPL-3.0-or-later
 */

#ifndef ALONZO_LED_H
#define ALONZO_LED_H

#include <stdbool.h>

/*
 * Status LEDs. Only two are used by the bootloader:
 *   RED   - burning / error
 *   GREEN - success
 */
enum alonzo_led_id {
	ALONZO_LED_RED = 0,
	ALONZO_LED_GREEN,
	ALONZO_LED_COUNT,
};

/* Configure every status LED (inactive) and turn them off. */
void led_init(void);

/* Set a status LED on (true) or off (false). Polarity is encapsulated. */
void led_set(enum alonzo_led_id id, bool on);

/* Toggle a status LED. */
void led_toggle(enum alonzo_led_id id);

/* Turn every status LED off. */
void led_all_off(void);

#endif /* ALONZO_LED_H */
```

## include/memory_layout.h
```c
/*
 * Copyright (c) 2026 HardenedLinux Animula
 * Author: Nala Ginrut <roy@hardenedlinux.org>
 *
 * SPDX-License-Identifier: LGPL-3.0-or-later
 */

/*
 * Single source of truth for the Alonzo flash layout.
 *
 * Everything is derived from ALONZO_BOOTLOADER_SIZE (CONFIG_ALONZO_BOOTLOADER_SIZE)
 * so that no magic addresses (0x08020000, 0x08040000, ...) are scattered through
 * the source. The bootloader, the application and the linker all agree on these
 * values:
 *
 *   Bootloader:  CONFIG_FLASH_LOAD_OFFSET = 0
 *                CONFIG_FLASH_LOAD_SIZE   = ALONZO_BOOTLOADER_SIZE
 *   Application: CONFIG_FLASH_LOAD_OFFSET = ALONZO_BOOTLOADER_SIZE
 *
 * Build-time validation below rejects an invalid (non-sector-aligned) size.
 */

#ifndef ALONZO_MEMORY_LAYOUT_H
#define ALONZO_MEMORY_LAYOUT_H

#include <zephyr/kernel.h>
#include <zephyr/sys/util.h>

/* STM32F411CEU6: 512 KB flash, 128 KB SRAM. */
#define ALONZO_FLASH_BASE   0x08000000u
#define ALONZO_FLASH_SIZE   (512u * 1024u)
#define ALONZO_FLASH_END    (ALONZO_FLASH_BASE + ALONZO_FLASH_SIZE)

#define ALONZO_SRAM_BASE    0x20000000u
#define ALONZO_SRAM_SIZE    (128u * 1024u)
#define ALONZO_SRAM_END     (ALONZO_SRAM_BASE + ALONZO_SRAM_SIZE)

/* Bootloader reserved size (configurable). */
#define ALONZO_BOOTLOADER_SIZE  CONFIG_ALONZO_BOOTLOADER_SIZE

/* Application region, immediately after the bootloader. */
#define ALONZO_APP_START    (ALONZO_FLASH_BASE + ALONZO_BOOTLOADER_SIZE)
#define ALONZO_APP_SIZE     (ALONZO_FLASH_SIZE - ALONZO_BOOTLOADER_SIZE)
#define ALONZO_APP_END      ALONZO_FLASH_END

/* Flash-API offsets are relative to the flash base. */
#define ALONZO_APP_OFFSET   (ALONZO_APP_START - ALONZO_FLASH_BASE)

/*
 * The STM32F411 flash is a single bank with sectors:
 *   S0..S3 = 16 KB, S4 = 64 KB, S5..S7 = 128 KB
 * A bootloader placed at FLASH_BASE is sector-aligned iff its size is one of
 * the cumulative sector boundaries below.
 */
#define _ALONZO_IS_SECTOR_ALIGNED(sz)					\
	((sz) == 0x04000u || (sz) == 0x08000u || (sz) == 0x0C000u ||	\
	 (sz) == 0x10000u || (sz) == 0x20000u || (sz) == 0x40000u ||	\
	 (sz) == 0x60000u || (sz) == 0x80000u)

BUILD_ASSERT(_ALONZO_IS_SECTOR_ALIGNED(ALONZO_BOOTLOADER_SIZE),
	     "ALONZO_BOOTLOADER_SIZE must be a sector-aligned size");

BUILD_ASSERT(ALONZO_BOOTLOADER_SIZE < ALONZO_FLASH_SIZE,
	     "bootloader size must be smaller than total flash");

/* The linker-enforced bootloader size must match the layout definition. */
BUILD_ASSERT(CONFIG_FLASH_LOAD_SIZE == ALONZO_BOOTLOADER_SIZE,
	     "CONFIG_FLASH_LOAD_SIZE must equal ALONZO_BOOTLOADER_SIZE");

#endif /* ALONZO_MEMORY_LAYOUT_H */
```

## include/tf.h
```c
/*
 * Copyright (c) 2026 HardenedLinux Animula
 * Author: Nala Ginrut <roy@hardenedlinux.org>
 *
 * SPDX-License-Identifier: LGPL-3.0-or-later
 */

#ifndef ALONZO_TF_H
#define ALONZO_TF_H

#include <stdbool.h>
#include <stddef.h>

/* The TF (micro-SD) card carries update files at the root of a FAT volume. */
#define ALONZO_TF_MOUNT_POINT "/SD:"
#define ALONZO_FW_PATH        ALONZO_TF_MOUNT_POINT "/firmware.bin"
#define ALONZO_BLE_PATH       ALONZO_TF_MOUNT_POINT "/ble.bin"
#define ALONZO_FLM_PATH       ALONZO_TF_MOUNT_POINT "/FR8010H.FLM"

/* Mount the TF card FAT filesystem. Returns 0 on success, -errno otherwise. */
int tf_mount(void);

/* Unmount the TF card filesystem. Returns 0 on success, -errno otherwise. */
int tf_unmount(void);

/* Return true if @p path exists and, if @p size_out is non-NULL, its size. */
bool tf_file_exists(const char *path, size_t *size_out);

#endif /* ALONZO_TF_H */
```

## include/update.h
```c
/*
 * Copyright (c) 2026 HardenedLinux Animula
 * Author: Nala Ginrut <roy@hardenedlinux.org>
 *
 * SPDX-License-Identifier: LGPL-3.0-or-later
 */

#ifndef ALONZO_UPDATE_H
#define ALONZO_UPDATE_H

/*
 * Apply any pending TF updates, in fixed order: firmware.bin first, then
 * ble.bin. Requires the TF card to already be mounted.
 *
 * Returns 0 if all applicable updates succeeded (or none were present), or a
 * negative errno on the first failure. On failure the offending file is kept
 * so the next boot retries.
 */
int update_apply(void);

#endif /* ALONZO_UPDATE_H */
```

## src/app_jump.c
```c
/*
 * Copyright (c) 2026 HardenedLinux Animula
 * Author: Nala Ginrut <roy@hardenedlinux.org>
 *
 * SPDX-License-Identifier: LGPL-3.0-or-later
 */

#include "app_jump.h"
#include "memory_layout.h"

#include <cmsis_core.h>
#include <zephyr/kernel.h>

typedef void (*reset_handler_t)(void);

static bool msp_in_sram(uint32_t msp)
{
	return msp > ALONZO_SRAM_BASE && msp < ALONZO_SRAM_END;
}

static bool addr_in_app_flash(uint32_t addr)
{
	return addr >= ALONZO_APP_START && addr < ALONZO_APP_END;
}

bool app_image_valid(uint32_t app_start)
{
	const uint32_t *vt = (const uint32_t *)app_start;
	uint32_t msp = vt[0];
	uint32_t reset = vt[1];

	/* Reset handler must be within the app flash and thumb (bit 0 clear). */
	return msp_in_sram(msp) && addr_in_app_flash(reset) && ((reset & 1u) == 0u);
}

void app_jump(uint32_t app_start)
{
	const uint32_t *vt = (const uint32_t *)app_start;
	uint32_t msp = vt[0];
	uint32_t reset = vt[1];

	if (!app_image_valid(app_start)) {
		return;
	}

	/* No interrupts past this point. */
	__disable_irq();

	/* Stop and clear SysTick so the app gets a clean slate. */
	SysTick->CTRL = 0;
	SysTick->LOAD = 0;
	SysTick->VAL = 0;
	SCB->ICSR |= SCB_ICSR_PENDSTCLR_Msk;
	SCB->ICSR |= SCB_ICSR_PENDSVCLR_Msk;

	/* Clear every pending NVIC interrupt. */
	uint32_t n_irq_lines = ((SCnSCB->ICTR & SCnSCB_ICTR_INTLINESNUM_Msk)
				>> SCnSCB_ICTR_INTLINESNUM_Pos) + 1;
	for (uint32_t i = 0; i < n_irq_lines; i++) {
		NVIC->ICER[i] = 0xFFFFFFFFu;
	}

	/* Relocate the vector table and install the new stack pointer. */
	SCB->VTOR = app_start;
	__set_MSP(msp);

	/* Jump to the application reset handler; it never returns. */
	((reset_handler_t)reset)();

	__builtin_unreachable();
}
```

## src/ble_update.c
```c
/*
 * Copyright (c) 2026 HardenedLinux Animula
 * Author: Nala Ginrut <roy@hardenedlinux.org>
 *
 * SPDX-License-Identifier: LGPL-3.0-or-later
 */

#include "ble_update.h"
#include "cortexm.h"
#include "fr8016.h"
#include "tf.h"

#include <errno.h>
#include <zephyr/kernel.h>
#include <zephyr/sys/printk.h>

/*
 * FR8016HA (BLE) firmware update, implemented over SWD.
 *
 * The FR8016HA is a separate Cortex-M3 co-processor. The update path does NOT
 * use the FREQCHIP private UART downloader protocol: the STM32 bit-bangs SWD on
 * PA2/PA3 (USART2 in normal operation) and programs the FR8016HA internal flash
 * through the vendor .FLM flash algorithm read from the TF card (see fr8016.c).
 *
 * update_apply() calls ble_update() only when /SD:ble.bin is present. The BLE
 * update then runs only when the .FLM is also present; either file missing means
 * "no update, keep whatever is there". On success both files are deleted by
 * fr8016_update().
 */
int ble_update(void)
{
#if defined(CONFIG_ALONZO_FR8016_SWD_SELFTEST)
	/*
	 * Bring-up hook (Phases 1-4): first the SWD/DAP/debug chain
	 * (reset -> DPIDR -> power up -> AP IDR -> halt -> PC/SP/xPSR -> run),
	 * then a static validation of the .FLM parsed from the TF card.
	 */
	int rc = cm_selftest();

	if (rc != 0) {
		return rc;
	}
	return fr8016_flm_selftest(ALONZO_FLM_PATH);
#else
	/*
	 * Both ble.bin and FR8010H.FLM must be present. update.c already gated on
	 * ble.bin; check the .FLM here and skip (keeping ble.bin) if it is absent.
	 */
	if (!tf_file_exists(ALONZO_FLM_PATH, NULL)) {
		printk("ble_update: %s missing, keeping ble.bin\n", ALONZO_FLM_PATH);
		return 0;
	}
	return fr8016_update(ALONZO_BLE_PATH, ALONZO_FLM_PATH);
#endif
}
```

## src/firmware_update.c
```c
/*
 * Copyright (c) 2026 HardenedLinux Animula
 * Author: Nala Ginrut <roy@hardenedlinux.org>
 *
 * SPDX-License-Identifier: LGPL-3.0-or-later
 */

#include "firmware_update.h"
#include "led.h"
#include "memory_layout.h"
#include "tf.h"

#include <errno.h>
#include <stdint.h>
#include <zephyr/device.h>
#include <zephyr/drivers/flash.h>
#include <zephyr/fs/fs.h>
#include <zephyr/kernel.h>
#include <zephyr/sys/printk.h>

/*
 * Read/write chunk size. It is a multiple of the flash write block size (the
 * STM32F411 reports 1 byte, so any size is fine) and of the SD sector size
 * (512 bytes) for efficient TF reads.
 */
#define FW_CHUNK_SIZE 512u

/*
 * Blink cadence for the red LED during the write phase (ms). The flash API is
 * synchronous (the CPU is blocked inside flash_write), so per-chunk toggling
 * would be an invisible flicker; gate the toggle on this period instead so the
 * red LED shows a visible few-Hz blink.
 */
#define BURN_BLINK_PERIOD_MS 100

static const struct device *flash_device(void)
{
	return DEVICE_DT_GET(DT_CHOSEN(zephyr_flash_controller));
}

/*
 * Toggle-only blink helper. It never decides the LED's final state: it only
 * flips RED while the burn is in progress. The final RED/GREEN state is
 * resolved once, by main(), after the update succeeds or fails.
 */
static void burn_blink(int64_t *last_toggle_ms)
{
	int64_t now = k_uptime_get();

	if ((now - *last_toggle_ms) >= BURN_BLINK_PERIOD_MS) {
		led_toggle(ALONZO_LED_RED);
		*last_toggle_ms = now;
	}
}

/* Erase [app_offset, app_offset + app_size) sector by sector. */
static int erase_app_region(const struct device *dev, uint32_t app_offset,
			    uint32_t app_size)
{
	off_t end = (off_t)app_offset + app_size;
	off_t off = (off_t)app_offset;

	while (off < end) {
		struct flash_pages_info info;
		int rc = flash_get_page_info_by_offs(dev, off, &info);

		if (rc != 0) {
			return rc;
		}
		rc = flash_erase(dev, info.start_offset, info.size);
		if (rc != 0) {
			return rc;
		}
		led_toggle(ALONZO_LED_RED); /* blink once per erased sector */
		off = info.start_offset + info.size;
	}

	return 0;
}

int firmware_update(void)
{
	const struct device *dev = flash_device();
	struct fs_file_t file;
	struct fs_dirent entry;
	uint32_t app_offset = ALONZO_APP_OFFSET;
	int rc;

	if (!device_is_ready(dev)) {
		printk("firmware_update: flash device not ready\n");
		return -ENODEV;
	}

	fs_file_t_init(&file);

	rc = fs_open(&file, ALONZO_FW_PATH, FS_O_READ);
	if (rc != 0) {
		printk("firmware_update: open %s failed (%d)\n", ALONZO_FW_PATH, rc);
		return rc;
	}

	/* Size / range validation: image must fit inside the app region. */
	rc = fs_stat(ALONZO_FW_PATH, &entry);
	if (rc != 0) {
		printk("firmware_update: stat failed (%d)\n", rc);
		goto out_close;
	}
	if (entry.size == 0 || entry.size > ALONZO_APP_SIZE) {
		printk("firmware_update: invalid size %u (max %u)\n",
		       (unsigned int)entry.size, (unsigned int)ALONZO_APP_SIZE);
		rc = -EFBIG;
		goto out_close;
	}

	printk("firmware_update: erasing app 0x%x..0x%x\n",
	       (unsigned int)app_offset, (unsigned int)(app_offset + ALONZO_APP_SIZE));

	/*
	 * Actual burn: red blinks while erasing (per sector) and writing. The
	 * set(true) here only starts the blink; it is not a final state. Final
	 * RED/GREEN is resolved by main() after update_apply() returns.
	 */
	led_set(ALONZO_LED_RED, true);
	rc = erase_app_region(dev, app_offset, ALONZO_APP_SIZE);
	if (rc != 0) {
		printk("firmware_update: erase failed (%d)\n", rc);
		goto out_close;
	}

	{
		static uint8_t buf[FW_CHUNK_SIZE];
		int64_t last_blink_ms = k_uptime_get();
		off_t off = (off_t)app_offset;
		ssize_t r;

		while ((r = fs_read(&file, buf, sizeof(buf))) > 0) {
			rc = flash_write(dev, off, buf, (size_t)r);
			if (rc != 0) {
				printk("firmware_update: write at 0x%x failed (%d)\n",
				       (unsigned int)off, rc);
				goto out_close;
			}
			off += (size_t)r;
			burn_blink(&last_blink_ms);
		}

		if (r < 0) {
			printk("firmware_update: read failed (%d)\n", (int)r);
			rc = (int)r;
			goto out_close;
		}
	}

	rc = fs_close(&file);
	if (rc != 0) {
		printk("firmware_update: close failed (%d)\n", rc);
		return rc;
	}

	/* Success: delete the update file. */
	rc = fs_unlink(ALONZO_FW_PATH);
	if (rc != 0) {
		printk("firmware_update: unlink failed (%d)\n", rc);
		return rc;
	}

	printk("firmware_update: success\n");
	return 0;

out_close:
	/* Failure: keep the file for the next boot; main() drives the final LED. */
	(void)fs_close(&file);
	return rc;
}
```

## src/led.c
```c
/*
 * Copyright (c) 2026 HardenedLinux Animula
 * Author: Nala Ginrut <roy@hardenedlinux.org>
 *
 * SPDX-License-Identifier: LGPL-3.0-or-later
 */

#include "led.h"

#include <zephyr/device.h>
#include <zephyr/drivers/gpio.h>
#include <zephyr/kernel.h>

/*
 * LED -> GPIO mapping.
 *
 * HARDWARE VERIFICATION STATUS: UNVERIFIED.
 *
 * The physical colour of each LED has not been confirmed on real hardware.
 * The mapping below (led0 -> RED, led1 -> GREEN) is a placeholder that must
 * be validated before field use. Polarity (active-low) is NOT assumed here:
 * it is taken from the devicetree gpio flags, so led_set(.., true) always
 * means "on" regardless of active-low/active-high.
 */
#define LED_RED_NODE   DT_ALIAS(led0)
#define LED_GREEN_NODE DT_ALIAS(led1)

static const struct gpio_dt_spec led_specs[ALONZO_LED_COUNT] = {
	[ALONZO_LED_RED]   = GPIO_DT_SPEC_GET(LED_RED_NODE, gpios),
	[ALONZO_LED_GREEN] = GPIO_DT_SPEC_GET(LED_GREEN_NODE, gpios),
};

void led_init(void)
{
	for (int i = 0; i < ALONZO_LED_COUNT; i++) {
		const struct gpio_dt_spec *spec = &led_specs[i];

		if (!gpio_is_ready_dt(spec)) {
			continue;
		}
		gpio_pin_configure_dt(spec, GPIO_OUTPUT_INACTIVE);
	}
}

void led_set(enum alonzo_led_id id, bool on)
{
	const struct gpio_dt_spec *spec;

	if ((unsigned int)id >= ALONZO_LED_COUNT) {
		return;
	}
	spec = &led_specs[id];
	if (!gpio_is_ready_dt(spec)) {
		return;
	}
	gpio_pin_set_dt(spec, on ? 1 : 0);
}

void led_toggle(enum alonzo_led_id id)
{
	const struct gpio_dt_spec *spec;

	if ((unsigned int)id >= ALONZO_LED_COUNT) {
		return;
	}
	spec = &led_specs[id];
	if (!gpio_is_ready_dt(spec)) {
		return;
	}
	gpio_pin_toggle_dt(spec);
}

void led_all_off(void)
{
	for (int i = 0; i < ALONZO_LED_COUNT; i++) {
		led_set((enum alonzo_led_id)i, false);
	}
}
```

## src/tf.c
```c
/*
 * Copyright (c) 2026 HardenedLinux Animula
 * Author: Nala Ginrut <roy@hardenedlinux.org>
 *
 * SPDX-License-Identifier: LGPL-3.0-or-later
 */

#include "tf.h"

#include <ff.h>
#include <zephyr/fs/fs.h>

static FATFS tf_fs;
static struct fs_mount_t tf_mp = {
	.type = FS_FATFS,
	.mnt_point = ALONZO_TF_MOUNT_POINT,
	.fs_data = &tf_fs,
};

int tf_mount(void)
{
	return fs_mount(&tf_mp);
}

int tf_unmount(void)
{
	return fs_unmount(&tf_mp);
}

bool tf_file_exists(const char *path, size_t *size_out)
{
	struct fs_dirent entry;
	int rc = fs_stat(path, &entry);

	if (rc != 0) {
		return false;
	}
	if (size_out != NULL) {
		*size_out = entry.size;
	}
	return true;
}
```
